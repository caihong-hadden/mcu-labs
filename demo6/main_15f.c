/**
 * @file main_15f.c
 * @brief STC15F 系列平台 (蓝桥杯 CT107D 架构) - 独立按键实时控制板载 LED
 * @details 硬件平台: STC15F2K60S2 / IAP15F2K61S2 开发板 (蓝桥杯 CT107D/CT107S)
 *          时钟频率: 11.0592MHz (STC 1T 模式)
 *          硬件控制:
 *          1. 蓝桥杯 J5 跳线帽接在 BTN 端 (独立按键模式):
 *             - 按键 S7 连接 P3.0 引脚 (按下为低电平 0)
 *             - 按键 S6 连接 P3.1 引脚 (按下为低电平 0)
 *          2. 锁存器配置: J13 接 IO 模式，P4.2 输出低电平使能 WR 门禁。
 *          3. 选通 74HC138 Y4C 锁存器: P27=1, P26=0, P25=0 (LED 锁存使能)。
 *          4. P0.0 对应板载指示灯 L1，P0.1 对应板载指示灯 L2。
 *          5. 实现按压 S7 时 L1 实时点亮，松开熄灭；按压 S6 时 L2 实时点亮，松开熄灭。
 */

#include <STC15F2K60S2.H>

/* 按键与板载外设引脚映射 */
sbit Key_S7 = P3^0;   // 独立按键 S7
sbit Key_S6 = P3^1;   // 独立按键 S6

/**
 * @brief 主函数
 */
void main(void)
{
    unsigned char led_buf = 0xFF; // LED 缓冲寄存器，默认全灭 (0xFF)

    /* 1. 开启 74HC138 译码与 LED (Y4C) 锁存使能 */
    P42 = 0;    // WR 门禁使能 (J13 IO 模式)
    P27 = 1;
    P26 = 0;
    P25 = 0;    // Y4C 选通使能 (74HC573 LE 保持高电平透明传输)

    /* 2. 初始关闭所有 LED */
    P0 = 0xFF;

    while (1)
    {
        led_buf = 0xFF; // 每次循环基准为全部熄灭

        /* 轮询 S7 按键 (控制 L1 / P0.0) */
        if (Key_S7 == 0)
        {
            led_buf &= ~0x01; // S7 按下时 L1 点亮 (P0.0 置 0)
        }

        /* 轮询 S6 按键 (控制 L2 / P0.1) */
        if (Key_S6 == 0)
        {
            led_buf &= ~0x02; // S6 按下时 L2 点亮 (P0.1 置 0)
        }

        /* 刷新输出到 P0 端口驱动板载指示灯 */
        P0 = led_buf;
    }
}
